## config/west.yml
```yaml
manifest:
  remotes:
    - name: zmkfirmware
      url-base: https://github.com/zmkfirmware
  projects:
    - name: zmk
      remote: zmkfirmware
      revision: 8776911da5005d42cd0bdf108b23deca16d7ec82
      import: app/west.yml
  self:
    path: config
```
